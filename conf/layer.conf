## conf/layer.conf
```bitbake
# We have a conf and classes directory, add to BBPATH
BBPATH .= ":${LAYERDIR}"

# We have recipes-* directories, add to BBFILES
BBFILES += "${LAYERDIR}/recipes-*/*/*.bb \
            ${LAYERDIR}/recipes-*/*/*.bbappend"

BBFILE_COLLECTIONS += "meta-beacon-common"
BBFILE_PATTERN_meta-beacon-common := "^${LAYERDIR}/"
BBFILE_PRIORITY_meta-beacon-common := "5"

LAYERSERIES_COMPAT_meta-beacon-common = "rocko warrior hardknott honister"

IMAGE_INSTALL:append = " \
		beacon-eeprom-decoder \
                "
```
